## main/Kconfig.projbuild
```kconfig
menu "Skyline Window Configuration"

    config MAX_SPEED
        int "Motor maximum speed"
        default 128
        help
            Duty cycle that control the motor max speed. Range from 0-255. 

    config MIN_SPEED
        int "Motor startup speed"
        default 20
        help
            Duty cycle that control the motor starup speed. Range from 0-255. 

    config LIMIT_INTERVAL
        int "Maximum operation Interval (us)"
        default 40000000
        help
            Maximum operation interval for motor (in ms).

    config WIFI_SSID
        string "WiFi SSID"
        default "myssid"
        help
            SSID (network name) to connect to.

    config WIFI_PWD
        string "WiFi Password"
        default "mypassword"
        help
            WiFi password (WPA2) to use.

    config LISTEN_INTERVAL
        int "WiFi listen interval"
        default 3
        help
            Interval for station to listen to beacon from AP. The unit of listen interval is one beacon interval.
            For example, if beacon interval is 100 ms and listen interval is 3, the interval for station to listen
            to beacon is 300 ms.

    choice POWER_SAVE_MODE
        prompt "choose power save mode"
        default POWER_SAVE_MIN
        help
            Power save mode for the esp32 to use. Modem sleep mode includes minimum and maximum power save modes.
            In minimum power save mode, station wakes up every DTIM to receive beacon. Broadcast data will not be
            lost because it is transmitted after DTIM. However, it can not save much more power if DTIM is short
            for DTIM is determined by AP.
            In maximum power save mode, station wakes up every listen interval to receive beacon. Broadcast data
            may be lost because station may be in sleep state at DTIM time. If listen interval is longer, more power
            is saved but broadcast data is more easy to lose.

        config POWER_SAVE_NONE
            bool "none"
        config POWER_SAVE_MIN
            bool "minimum power save"
        config POWER_SAVE_MAX
            bool "maximum power save"
    endchoice

    choice MAX_CPU_FREQ
        prompt "Maximum CPU frequency"
        default MAX_CPU_FREQ_80
        help
            Maximum CPU frequency to use for dynamic frequency scaling.

        config MAX_CPU_FREQ_80
            bool "80 MHz"
        config MAX_CPU_FREQ_160
            bool "160 MHz"
        config MAX_CPU_FREQ_240
            bool "240 MHz"
    endchoice

    config MAX_CPU_FREQ_MHZ
        int
        default 80 if MAX_CPU_FREQ_80
        default 160 if MAX_CPU_FREQ_160
        default 240 if MAX_CPU_FREQ_240


    choice MIN_CPU_FREQ
        prompt "Minimum CPU frequency"
        default MIN_CPU_FREQ_10M
        help
            Minimum CPU frequency to use for dynamic frequency scaling.
            Should be set to XTAL frequency or XTAL frequency divided by integer.

        config MIN_CPU_FREQ_40M
            bool "40 MHz (use with 40MHz XTAL)"
            depends on IDF_TARGET_ESP32S2 || ESP32_XTAL_FREQ_40 || ESP32_XTAL_FREQ_AUTO
        config MIN_CPU_FREQ_20M
            bool "20 MHz (use with 40MHz XTAL)"
            depends on IDF_TARGET_ESP32S2 || ESP32_XTAL_FREQ_40 || ESP32_XTAL_FREQ_AUTO
        config MIN_CPU_FREQ_10M
            bool "10 MHz (use with 40MHz XTAL)"
            depends on IDF_TARGET_ESP32S2 || ESP32_XTAL_FREQ_40 || ESP32_XTAL_FREQ_AUTO
        config MIN_CPU_FREQ_26M
            bool "26 MHz (use with 26MHz XTAL)"
            depends on ESP32_XTAL_FREQ_26 || ESP32_XTAL_FREQ_AUTO
        config MIN_CPU_FREQ_13M
            bool "13 MHz (use with 26MHz XTAL)"
            depends on ESP32_XTAL_FREQ_26 || ESP32_XTAL_FREQ_AUTO
    endchoice

    config MIN_CPU_FREQ_MHZ
        int
        default 40 if MIN_CPU_FREQ_40M
        default 20 if MIN_CPU_FREQ_20M
        default 10 if MIN_CPU_FREQ_10M
        default 26 if MIN_CPU_FREQ_26M
        default 13 if MIN_CPU_FREQ_13M

endmenu
```
